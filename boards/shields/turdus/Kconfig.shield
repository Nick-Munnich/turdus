## boards/shields/turdus/Kconfig.shield
```kconfig
config SHIELD_TURDUS_LEFT
    def_bool $(shields_list_contains,turdus_left)

config SHIELD_TURDUS_RIGHT
    def_bool $(shields_list_contains,turdus_right)
```
